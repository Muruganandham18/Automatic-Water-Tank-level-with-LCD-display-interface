//**********************AUTOMATIC_WATER_TANK_LEVEL_WITH_ULTRASONIC_SENSOR**********************************//
//NAME:S Muruganandham
//Education: B.Tech in ELECTRONICS AND COMMUNICATION ENGINEERING AT Pondicherry University//
//This library is for interfacing display to Arduino
#include <PCD8544.h>

//Declare the variable
//High is th distance between the maximum level of water to sensor(Change with this with your tank value)
//Low is the lowest level of the tank fron the sensor(Change with this with your tank value)
int high=20,low=77,s=0,o=0,per2;
int A=0x00;
int B=0xff;
float x=-1.767 ,y=135.357;
int level , per, M ,button=0;
int time=0,distance=0,motor=0;
int inflow1=4 ,inflow2=2,outflow1=4,outflow2=3,sh=100;
//trigger pin in ultra sonic
const int trigPin = 8;
//Echo pin in ultra sonic
const int echoPin = 9;


// The dimensions of the LCD (in pixels)...
static const byte LCD_WIDTH = 84;
static const byte LCD_HEIGHT = 48;

// tank empty and many interface
static const byte TANK_WIDTH = 84;
static const byte TANK_HEIGHT =48;
static const byte TANK[] = {
0x00, 0x00, 0x00, 0x00, 0x00, 0x00, 0x00, 0x00, 0x00, 0x00, 0x00, 0x00, 0x00, 0x00, 0x00, 0x00,
0x00, 0x00, 0x00, 0x00, 0x00, 0x00, 0x00, 0x00, 0x00, 0x00, 0x00, 0x00, 0x00, 0x9E, 0x92, 0x92,
0x92, 0x92, 0xF2, 0x00, 0xFE, 0x12, 0x12, 0x12, 0xFE, 0x00, 0xFE, 0x08, 0x10, 0x10, 0x60, 0xFE,
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0x20, 0x20, 0x20, 0x20, 0x20, 0x20, 0x3F, 0x00,    };
// level 1
static const byte TANK1_WIDTH = 22;
static const byte TANK1_HEIGHT =25;
static const byte l1[] = {
0x00, 0x00, 0x00, 0x00, 0x00, 0x00, 0x00, 0x00, 0x00, 0x00, 0x00, 0x00, 0x00, 0x00, 0x00, 0x00,
0x00, 0x00, 0x00, 0x00, 0x00, 0x00, 0x00, 0x00, 0x00, 0x00, 0x00, 0x00, 0x00, 0x00, 0x00, 0x00,
0x00, 0x00, 0x00, 0x00, 0x00, 0x00, 0x00, 0x00, 0x00, 0x00, 0x00, 0x00, 0xF8, 0xF8, 0xF8, 0xF8,
0xF8, 0xF8, 0xF8, 0xF8, 0xF8, 0xF8, 0xF8, 0xF8, 0xF8, 0xF8, 0xF8, 0xF8, 0xF8, 0xF8, 0xF8, 0xF8,
0xF8, 0xF8, 0x01, 0x01, };

static const byte l2[] = {
0x00, 0x00, 0x00, 0x00, 0x00, 0x00, 0x00, 0x00, 0x00, 0x00, 0x00, 0x00, 0x00, 0x00, 0x00, 0x00,
0x00, 0x00, 0x00, 0x00, 0x00, 0x00, 0x80, 0x80, 0x80, 0x80, 0x80, 0x80, 0x80, 0x80, 0x80, 0x80,
0x80, 0x80, 0x80, 0x80, 0x80, 0x80, 0x80, 0x80, 0x80, 0x80, 0x80, 0x80, 0xFF, 0xFF, 0xFF, 0xFF,
0xFF, 0xFF, 0xFF, 0xFF, 0xFF, 0xFF, 0xFF, 0xFF, 0xFF, 0xFF, 0xFF, 0xFF, 0xFF, 0xFF, 0xFF, 0xFF,
0xFF, 0xFF, 0x01, 0x01, };
static const byte l3[] = {
0x00, 0x00, 0x00, 0x00, 0x00, 0x00, 0x00, 0x00, 0x00, 0x00, 0x00, 0x00, 0x00, 0x00, 0x00, 0x00,
0x00, 0x00, 0x00, 0x00, 0x00, 0x00, 0xF8, 0xF8, 0xF8, 0xF8, 0xF8, 0xF8, 0xF8, 0xF8, 0xF8, 0xF8,
0xF8, 0xF8, 0xF8, 0xF8, 0xF8, 0xF8, 0xF8, 0xF8, 0xF8, 0xF8, 0xF8, 0xF8, 0xFF, 0xFF, 0xFF, 0xFF,
0xFF, 0xFF, 0xFF, 0xFF, 0xFF, 0xFF, 0xFF, 0xFF, 0xFF, 0xFF, 0xFF, 0xFF, 0xFF, 0xFF, 0xFF, 0xFF,
0xFF, 0xFF, 0x01, 0x01, };
static const byte l4[] = {
0xC0, 0xC0, 0xC0, 0xC0, 0xC0, 0xC0, 0xC0, 0xC0, 0xC0, 0xC0, 0xC0, 0xC0, 0xC0, 0xC0, 0xC0, 0xC0,
0xC0, 0xC0, 0xC0, 0xC0, 0xC0, 0xC0, 0xFF, 0xFF, 0xFF, 0xFF, 0xFF, 0xFF, 0xFF, 0xFF, 0xFF, 0xFF,
0xFF, 0xFF, 0xFF, 0xFF, 0xFF, 0xFF, 0xFF, 0xFF, 0xFF, 0xFF, 0xFF, 0xFF, 0xFF, 0xFF, 0xFF, 0xFF,
0xFF, 0xFF, 0xFF, 0xFF, 0xFF, 0xFF, 0xFF, 0xFF, 0xFF, 0xFF, 0xFF, 0xFF, 0xFF, 0xFF, 0xFF, 0xFF,
0xFF, 0xFF, 0x01, 0x01,  };
static const byte l5[] = {
0xFF, 0xFF, 0xFF, 0xFF, 0xFF, 0xFF, 0xFF, 0xFF, 0xFF, 0xFF, 0xFF, 0xFF, 0xFF, 0xFF, 0xFF, 0xFF,
0xFF, 0xFF, 0xFF, 0xFF, 0xFF, 0xFF, 0xFF, 0xFF, 0xFF, 0xFF, 0xFF, 0xFF, 0xFF, 0xFF, 0xFF, 0xFF,
0xFF, 0xFF, 0xFF, 0xFF, 0xFF, 0xFF, 0xFF, 0xFF, 0xFF, 0xFF, 0xFF, 0xFF, 0xFF, 0xFF, 0xFF, 0xFF,
0xFF, 0xFF, 0xFF, 0xFF, 0xFF, 0xFF, 0xFF, 0xFF, 0xFF, 0xFF, 0xFF, 0xFF, 0xFF, 0xFF, 0xFF, 0xFF,
0xFF, 0xFF, 0x01, 0x01, };
static const byte l0[] = {
0x00, 0x00, 0x00, 0x00, 0x00, 0x00, 0x00, 0x00, 0x00, 0x00, 0x00, 0x00, 0x00, 0x00, 0x00, 0x00,
0x00, 0x00, 0x00, 0x00, 0x00, 0x00, 0x00, 0x00, 0x00, 0x00, 0x00, 0x00, 0x00, 0x00, 0x00, 0x00,
0x00, 0x00, 0x00, 0x00, 0x00, 0x00, 0x00, 0x00, 0x00, 0x00, 0x00, 0x00, 0x00, 0x00, 0x00, 0x00,
0x00, 0x00, 0x00, 0x00, 0x00, 0x00, 0x00, 0x00, 0x00, 0x00, 0x00, 0x00, 0x00, 0x00, 0x00, 0x00,
0x00, 0x00, 0x00, 0x00,  };

static PCD8544 lcd;
void setup() {
Serial.begin(9600);
  
pinMode(11, OUTPUT);
lcd.begin(LCD_WIDTH, LCD_HEIGHT);
lcd.setCursor(0,1);
lcd.drawBitmap(TANK, TANK_WIDTH, TANK_HEIGHT);
 
 
}


void loop() {


long duration, inches, cm;

pinMode(trigPin, OUTPUT);

digitalWrite(trigPin, LOW);

delayMicroseconds(10);

digitalWrite(trigPin, HIGH);

delayMicroseconds(10);

digitalWrite(trigPin, LOW);

pinMode(echoPin, INPUT);


duration = pulseIn(echoPin, HIGH);
delay(500);

cm = duration / 29 / 2;
Serial.println(cm);
//formula to calculate the percentage
  per=(cm*(x))+(y);
  while(cm>=low && motor ==0){
  if(s<=100 && cm>=low){
    if (s>=50 && motor==0){
    motor=1;
    digitalWrite(11,HIGH);
    delay(1000);
    }
    delay(1);
    s=s+1;
  if(cm<low && motor == 0) {
    s=0;
}
}
}
    while(cm<=high+10 && motor==1 ){
    if(o<=20 && cm>=low){
    if (o>=10&& motor==0){
    motor=0;
    digitalWrite(11,LOW);
    delay(1000);
    }
    delay(0.1);
    o=o+1;
  if(cm<low && motor == 0) {
    o=0;
    
  }
  }
    
      }
  //For printing the level on the display
  lcd.setCursor(0, 4);
  lcd.print("Motor:");
  float a=59,b=3;
  if(per>=20 && per<=40){
  lcd.setCursor(a,b);
  lcd.drawBitmap(l1,22, 25);
  }
  if(per>40 && per<=60){
  lcd.setCursor(a,b);
  lcd.drawBitmap(l2,22,25);
  }
  if(per>60 && per<=80){
  lcd.setCursor(a,b);
  lcd.drawBitmap(l3,22,25);
  }
  if(per>80 && per<=90){
  lcd.setCursor(a,b);
  lcd.drawBitmap(l4,22,25);
  }
  if(per>90){
  lcd.setCursor(a,b);
  lcd.drawBitmap(l5,22,25);
  }
  if(per<20){
  lcd.setCursor(a,b);
  lcd.drawBitmap(l0,22,25);
  }
  if(per<0){
  per=0;
  }
  if(per>=100){
  per=100;
  }
  lcd.setCursor(0, 2);
  lcd.print("LEVEL:");
  lcd.setCursor(0, 3);
  lcd.print(per,DEC);
  lcd.print("%   ");
  delay(10);
  if(motor==1){
    lcd.setCursor(0, 5);
    lcd.print("---ON---");
    }
 if(motor == 0){
  lcd.setCursor(0, 5);
  lcd.print("__OFF__");
    } 
  Serial.println(per);
   delay(10);
 pinMode(2,OUTPUT);  
 if(per>80){
    digitalWrite(2,HIGH);
    delay(100);
    digitalWrite(2,LOW);
    delay(10);
    } 
  if(per<10){
    digitalWrite(2,LOW);
    delay(1);
    }   
  if((per<=80 && motor==1) || (per2<per)){
    digitalWrite(2,HIGH);
    delay(1000);
    digitalWrite(2,LOW);
    delay(1000);
    }   
  Serial.println(per);
   delay(100);
   per2=per;
}

long microsecondsToCentimeters(long microseconds)

{return microseconds / 29 / 2;}

